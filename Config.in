## glibc_defconfig
```kconfig
# Glibc based toolchain

BR2_SSP_NONE=y
BR2_TOOLCHAIN_USES_GLIBC=y
BR2_TOOLCHAIN_BUILDROOT_GLIBC=y
BR2_TOOLCHAIN_BUILDROOT_LIBC="glibc"
BR2_PACKAGE_GLIBC=y
BR2_GLIBC_VERSION_2_23=y
BR2_GLIBC_VERSION_STRING="2.23"
BR2_TOOLCHAIN_HAS_NATIVE_RPC=y
BR2_USE_WCHAR=y
BR2_ENABLE_LOCALE=y
BR2_TOOLCHAIN_HAS_THREADS_DEBUG=y
BR2_TOOLCHAIN_HAS_SSP=y
BR2_TOOLCHAIN_ARM_HAS_SYNC_8=y
BR2_TOOLCHAIN_HAS_SYNC_8=y
BR2_GENERATE_LOCALE=""
```

## navit_defconfig
```kconfig
BR2_PACKAGE_GETTEXT=y
BR2_PACKAGE_OBSIDIAN_CURSORS=y
BR2_PACKAGE_BITSTREAM_VERA=y
BR2_PACKAGE_DEJAVU=y
BR2_PACKAGE_INCONSOLATA=y
BR2_PACKAGE_LIBERATION=y
# BR2_PACKAGE_PYTOUCH=y
BR2_PACKAGE_TSPRESS=y
BR2_PACKAGE_FBSET=y
BR2_PACKAGE_QT5=y
BR2_PACKAGE_QT5_VERSION_LATEST=y
# BR2_PACKAGE_QT5_VERSION_5_6=y

BR2_PACKAGE_QT5BASE_LINUXFB=y
BR2_PACKAGE_QT5BASE_EGLFS=y
BR2_PACKAGE_QT5BASE_DEFAULT_QPA="eglfs"
BR2_PACKAGE_QT5BASE_FONTCONFIG=y
BR2_PACKAGE_QT5BASE_GIF=y
BR2_PACKAGE_QT5BASE_JPEG=y
BR2_PACKAGE_QT5BASE_PNG=y
BR2_PACKAGE_QT5SVG=y
BR2_PACKAGE_QT5BASE_ICU=y
BR2_PACKAGE_QT5BASE_TSLIB=y
BR2_PACKAGE_QT5IMAGEFORMATS=y
BR2_PACKAGE_QT5MULTIMEDIA=y
BR2_PACKAGE_QT5SENSORS=y
BR2_PACKAGE_QT5SERIALBUS=y
BR2_PACKAGE_QT5WEBSOCKETS=y

BR2_PACKAGE_QT5BASE=y
BR2_PACKAGE_QT5BASE_CUSTOM_CONF_OPTS=""
BR2_PACKAGE_QT5BASE_LICENSE_APPROVED=y
BR2_PACKAGE_QT5BASE_CONFIG_FILE=""
BR2_PACKAGE_QT5BASE_NETWORK=y
BR2_PACKAGE_QT5BASE_SQL=y
BR2_PACKAGE_QT5BASE_SQLITE_NONE=y
BR2_PACKAGE_QT5BASE_TEST=y
BR2_PACKAGE_QT5BASE_XML=y
BR2_PACKAGE_QT5BASE_GUI=y
BR2_PACKAGE_QT5DECLARATIVE=y
BR2_PACKAGE_QT5XMLPATTERNS=y
BR2_PACKAGE_ZLIB=y
BR2_PACKAGE_FREETYPE=y
BR2_PACKAGE_PCRE=y
BR2_PACKAGE_PCRE_16=y
BR2_PACKAGE_PCRE_UTF=y
BR2_PACKAGE_LIBEVDEV=y

BR2_PACKAGE_LIBGLIB2=y
BR2_PACKAGE_NAVIT=y
BR2_PACKAGE_NAVIT_QT5=y
BR2_PACKAGE_NAVIT_SPOTIFY_PLAYER=y
BR2_PACKAGE_NAVIT_J1850_PLUGIN=n
BR2_PACKAGE_NAVIT_GPSD_VEHICLE=y
BR2_PACKAGE_NAVIT_VEHICLE_GPSD=y
BR2_PACKAGE_GPSD_DEVICES="/dev/ttyUSB0"
BR2_PACKAGE_GPSD_SIRF=y

BR2_PACKAGE_MPG123=y
BR2_PACKAGE_ALSA_UTILS=y
BR2_PACKAGE_ALSA_UTILS_AMIXER=y
BR2_PACKAGE_ALSA_UTILS_APLAY=y
BR2_PACKAGE_ESPEAK=y
BR2_PACKAGE_ESPEAK_AUDIO_BACKEND_ALSA=y

BR2_PACKAGE_NTP=y
BR2_PACKAGE_NTP_NTPQ=y
BR2_PACKAGE_GPSD_PPS=y
BR2_PACKAGE_PPS_TOOLS=y
BR2_PACKAGE_NTP_NTPD_ATOM_PPS=y
BR2_PACKAGE_NTP_NTP_SHM_CLK=y

# pico2wave 
BR2_PACKAGE_POPT=y
```

## package/navit/Config.in
```kconfig
config BR2_PACKAGE_NAVIT
        bool "navit"
        depends on BR2_PACKAGE_GLIBC
        help
          The OpenSource vector based navigation software

          http://www.navit-project.org

if BR2_PACKAGE_NAVIT

config BR2_PACKAGE_NAVIT_GTK2
	bool "enable GTK2 graphics driver"
	select BR2_PACKAGE_LIBGTK2
	select BR2_PACKAGE_XORG7
	help
	  Enable the gtk2 (gtk_drawing_area) graphics driver

config BR2_PACKAGE_NAVIT_QT5
	bool "enable QT5 graphics driver"
	select BR2_PACKAGE_QT5DECLARATIVE
	select BR2_PACKAGE_QT5DECLARATIVE_QUICK
	select BR2_PACKAGE_QT5SVG
        select BR2_PACKAGE_QT5LOCATION
        select BR2_PACKAGE_QT5SENSORS
	help
	  Enable the QT5 (qml2) graphics driver

config BR2_PACKAGE_NAVIT_J1850_PLUGIN
	bool "enabled the j1850 plugin"
	help
	  Enable the SAE-J1850 plugin

config BR2_PACKAGE_NAVIT_VEHICLE_GPSD
	bool "enabled gpsd vehicle"
	select BR2_PACKAGE_GPSD
	help
	  Enable the GPSD vehicle

endif
```
